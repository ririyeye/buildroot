## package/glog/Config.in
```kconfig
config BR2_PACKAGE_GLOG
	bool "glog"
	# __ELF__ not defined on Microblaze
	depends on !BR2_microblaze
	depends on BR2_INSTALL_LIBSTDCPP
	help
	  C++ implementation of the Google logging module

	  https://github.com/google/glog

comment "glog needs a toolchain w/ C++"
	depends on !BR2_microblaze
	depends on !BR2_INSTALL_LIBSTDCPP

if BR2_PACKAGE_GLOG

choice
	prompt "glog version"
	default USING_GLOG_NEW
	help
	  Select the version , old version may cause some link error

config USING_GLOG_OLD
	bool "glog old"
	help
	  old version glog may cause some link error

config USING_GLOG_NEW
	bool "glog new"
	help
	  new version glog from google:github
endchoice
endif
```

## package/python-pandas/Config.in
```kconfig
config BR2_PACKAGE_PYTHON_PANDAS
    bool "python-pandas"
    select BR2_PACKAGE_PYTHON_NUMPY
	select BR2_PACKAGE_PYTHON3_BZIP2
	select BR2_PACKAGE_PYTHON3_XZ
	select BR2_PACKAGE_PYTHON_PYTZ
	select BR2_PACKAGE_HOST_PYTHON_CYTHON
	help
      Peewee is a simple and small ORM. It has few (but expressive) concepts, making it easy to learn and intuitive to use.

      https://github.com/coleifer/peewee
```

## package/python-peewee/Config.in
```kconfig
config BR2_PACKAGE_PYTHON_PEEWEE
    bool "python-peewee"
    help
      Peewee is a simple and small ORM. It has few (but expressive) concepts, making it easy to learn and intuitive to use.

      https://github.com/coleifer/peewee
```
